## boards/arm/yahboom_ros_stm32f103/Kconfig.board
```kconfig
# STM32F103RCT6 Mini board configuration

# Copyright (c) 2020 WuhanStudio
# SPDX-License-Identifier: Apache-2.0

config BOARD_YAHBOOM_ROS_STM32F103
	bool "YAHBOOM ROS STM32F103RCT6 Board"
	select SOC_STM32F103XE
```

## boards/arm/yahboom_ros_stm32f103/Kconfig.defconfig
```kconfig
# STM32F103RCT6 Mini board configuration

# Copyright (c) 2020 WuhanStudio
# SPDX-License-Identifier: Apache-2.0

if BOARD_YAHBOOM_ROS_STM32F103

config BOARD
	default "yahboom_ros_stm32f103"

endif # BOARD_YAHBOOM_ROS_STM32F103
```

## boards/arm/yahboom_ros_stm32f103/Kconfig.yahboom_ros_stm32f103
```kconfig
# Copyright (c) 2020 WuhanStudio
# SPDX-License-Identifier: Apache-2.0

config BOARD_YAHBOOM_ROS_STM32F103
	select SOC_STM32F103XE
```

## boards/arm/yahboom_ros_stm32f103/board.yml
```yaml
board:
  name: yahboom_ros_stm32f103
  vendor: yahboom
  socs:
    - name: stm32f103xe
```

## drivers/Kconfig
```kconfig
# Copyright (c) 2021 Nordic Semiconductor ASA
# SPDX-License-Identifier: Apache-2.0

menu "Drivers"
rsource "sensor/Kconfig"
rsource "pwm/Kconfig"
rsource "rc/Kconfig"
rsource "pwm_servo/Kconfig"
endmenu
```

## drivers/input/Kconfig
```kconfig
# Copyright (c) 2024
# SPDX-License-Identifier: Apache-2.0

if INPUT

rsource "Kconfig.sbus_receiver"

endif # INPUT
```

## drivers/input/Kconfig.sbus_receiver
```kconfig
# Copyright (c) 2022 Jonathan Hahn
# SPDX-License-Identifier: Apache-2.0

config INPUT_SBUS_RECEIVER
	bool "RC S.Bus driver"
	select UART_INTERRUPT_DRIVEN
	help
	  Enable S.Bus RC receiver driver.

config RC_INIT_PRIORITY
	int "SBUS receiver init priority"
	depends on INPUT_SBUS_RECEIVER
	default 80
```

## drivers/input/Kconfig.stm32_qdec
```kconfig
# Copyright 2023 Google LLC
# SPDX-License-Identifier: Apache-2.0

config INPUT_STM32_QDEC
	bool "STM32 QDEC input driver"
	default y
	depends on DT_HAS_ST_STM32_INPUT_QDEC_ENABLED
	select USE_STM32_LL_TIM
	help
	  STM32 Quadrature Decoder input driver.
```

## drivers/motor/Kconfig
```kconfig
menuconfig MOTOR
	bool "Motor drivers"
	help
	  Enable config options for motor drivers.

if MOTOR

module = MOTOR
module-str = motor
source "subsys/logging/Kconfig.template.log_config"

config MOTOR_HBRIDGE
	bool "hbridge motor driver"
	default n
	depends on PWM
	help
	  This option enables the HBridge motor driver

config MOTOR_HBRIDGE_INIT_PRIORITY
	int "Hbridge init priority"
	default 90
	help
	  Servo initialization priority

endif # MOTOR
```

## drivers/pwm/Kconfig.pwm_servo
```kconfig
# Servo implementation that uses NRFX PWM driver
#
# Copyright (c) 2021 Daniel Veilleux
#
# SPDX-License-Identifier: LicenseRef-BSD-5-Clause-Nordic
#

config PWM_SERVO
	bool "Servo implementation that uses Zephyr PWM driver"
	default n
	help
	  Enable pwm servo driver

if PWM_SERVO

config PWM_SERVO_INIT_PRIORITY
	int "Servo init priority"
	default 90
	help
	  Servo initialization priority

endif #PWM_SERVO
```

## drivers/pwm/Kconfig.stm32_sw
```kconfig
# Copyright (c) 2024 Valentyn Shevchenko
# SPDX-License-Identifier: Apache-2.0

config PWM_STM32_SW
	bool "STM32 MCU SW PWM driver"
	default n
	# depends on DT_HAS_ST_STM32_PWM_ENABLED
	select USE_STM32_LL_TIM
	select USE_STM32_LL_RCC if SOC_SERIES_STM32F4X || SOC_SERIES_STM32F7X || SOC_SERIES_STM32H7X
	select RESET
	help
	  This option enables the PWM driver for STM32 family of
	  processors. Say y if you wish to use PWM port on STM32
	  MCU.
```

## drivers/pwm_servo/Kconfig
```kconfig
# Servo implementation that uses NRFX PWM driver
#
# Copyright (c) 2021 Daniel Veilleux
#
# SPDX-License-Identifier: LicenseRef-BSD-5-Clause-Nordic
#

menuconfig PWM_SERVO
	bool "Servo implementation that uses Zephyr PWM driver"
	select PWM
	help
	  Enable pwm servo driver

if PWM_SERVO

config PWM_SERVO_INIT_PRIORITY
	int "Servo init priority"
	default 90
	help
	  Servo initialization priority

module = PWM_SERVO
module-str = PWM-SERVO
source "${ZEPHYR_BASE}/subsys/logging/Kconfig.template.log_config"

endif #PWM_SERVO
```

## drivers/rc/Kconfig
```kconfig
# Copyright (c) 2022 Jonathan Hahn
# SPDX-License-Identifier: Apache-2.0

menuconfig RC
	bool "RC drivers"
	help
	  Enable config options for RC drivers.

if RC

config RC_INIT_PRIORITY
	int "Sensor init priority"
	default 90
	help
	  RC initialization priority.

rsource "sbus/Kconfig"
endif
```

## drivers/rc/sbus/Kconfig
```kconfig
# Copyright (c) 2022 Jonathan Hahn
# SPDX-License-Identifier: Apache-2.0

config RC_SBUS
    bool "RC S.Bus driver"
    # depends on UART_USE_RUNTIME_CONFIGURE
    depends on UART_INTERRUPT_DRIVEN
    help
      Enable S.Bus RC receiver driver.
```

## dts/bindings/input/sbus-receiver.yaml
```yaml
# Copyright (c) 2024
# SPDX-License-Identifier: Apache-2.0

description: SBUS Receiver

compatible: "sbus-receiver"

include: uart-device.yaml

properties:
  continue-on-frame-lost:
    type: boolean
    description: Continue generating events when SBUS reports frame lost

  continue-on-failsafe:
    type: boolean
    description: Continue generating events when SBUS reports failsafe

child-binding:
  description: SBUS channel node
  properties:
    channel:
      type: int
      required: true
      description: SBUS channel number (1-16)

    zephyr,axis:
      type: int
      required: true
      description: |
        The input code for the axis to report for the device, typically any of
        INPUT_ABS_* or INPUT_REL_*.
```

## dts/bindings/motor/hbridge.yaml
```yaml
description: Hbridge driver implementation

compatible: "hbridge"

include: base.yaml

properties:
  status:
    required: true
    type: string
    description: Human readable string describing the device's status

  pwms:
    required: true
    type: phandle-array
    description: PWM specifier driving the motor.
```

## dts/bindings/pwm/st,stm32-pwm-sw.yaml
```yaml
# Copyright (c) 2024 Valentyn Shevchenko
# SPDX-License-Identifier: Apache-2.0

description: STM32 software PWM — uses a hardware timer for timing but drives arbitrary GPIOs

compatible: "st,stm32-pwm-sw"

include: [pwm-controller.yaml, base.yaml]

properties:
  gpios:
    type: phandle-array
    required: true

  channels:
    type: array
    required: true
    description: Timer channel number (1-based) for each GPIO in the gpios array

  "#pwm-cells":
    const: 3
    description: |
      Number of items to expect in a PWM specifier:
      - channel: timer channel number (matches an entry in the channels array)
      - period: period in nanoseconds
      - flags: PWM_POLARITY_NORMAL or PWM_POLARITY_INVERTED

pwm-cells:
  - channel
  - period
  - flags
```

## dts/bindings/pwm_servo/pwm_servo.yaml
```yaml
# Copyright (c) 2024 Valentyn Shevchenko
# SPDX-License-Identifier: Apache-2.0

description: PWM-controlled servo motor

compatible: "pwm-servo"

include: base.yaml

properties:
  status:
    required: true
    type: string
    description: Human readable string describing the device's status

  init_value:
    type: int
    description: Initial position value [0, 100]
    required: true

  min_pulse_us:
    type: int
    description: Minimum pulse width in microseconds
    required: true

  max_pulse_us:
    type: int
    description: Maximum pulse width in microseconds
    required: true

  pwms:
    required: true
    type: phandle-array
    description: PWM specifier driving the servo motor.
```

## west.yml
```yaml
# SPDX-License-Identifier: Apache-2.0

manifest:
  defaults:
    remote: zephyrproject-rtos

  remotes:
    - name: zephyrproject-rtos
      url-base: https://github.com/zephyrproject-rtos

  projects:
    - name: zephyr
      revision: v3.7.0
      path: zephyr
      import:
        name-allowlist:
          - cmsis
          - hal_stm32
          - mcuboot
        path-prefix: zephyr_os   # applied to zephyr + all imported modules → zephyr_os/

  self:
    west-commands: scripts/west-commands.yml
```
