## CMakeLists.txt
```
# SPDX-License-Identifier: Apache-2.0

cmake_minimum_required(VERSION 3.20.0)

# Make Zephyr pick up the fake-pwm binding from this test's dts/bindings/.
set(DTS_ROOT ${CMAKE_CURRENT_SOURCE_DIR})

find_package(Zephyr REQUIRED HINTS $ENV{ZEPHYR_BASE})
project(pwm_servo_test)

target_sources(app PRIVATE
    src/main.c
    src/fake_pwm.c
)
```

## prj.conf
```kconfig
CONFIG_ZTEST=y
CONFIG_PWM=y
CONFIG_PWM_SERVO=y
CONFIG_LOG=y
```

## boards/native_sim.overlay
```dts
/*
 * Copyright (c) 2024 Valentyn Shevchenko
 * SPDX-License-Identifier: Apache-2.0
 */

#include <zephyr/dt-bindings/pwm/pwm.h>

/ {
	/*
	 * Fake PWM controller.  get_cycles_per_sec returns NSEC_PER_SEC so
	 * pulse_cycles == pulse_ns, making expected values easy to compute.
	 */
	fake_pwm0: fake-pwm@0 {
		compatible = "test,fake-pwm";
		reg = <0x0 0x1>;
		status = "okay";
		#pwm-cells = <3>;
	};

	/*
	 * Test servo: round numbers for easy expected-value arithmetic.
	 *   min = 1000 µs  →  PWM_USEC(1000) = 1 000 000 ns
	 *   max = 2000 µs  →  PWM_USEC(2000) = 2 000 000 ns
	 */
	servo_test: servo-test {
		compatible = "pwm-servo";
		status = "okay";
		init_value = <50>;
		min_pulse_us = <1000>;
		max_pulse_us = <2000>;
		pwms = <&fake_pwm0 0 PWM_MSEC(20) PWM_POLARITY_NORMAL>;
	};
};
```

## dts/bindings/test,fake-pwm.yaml
```yaml
# Copyright (c) 2024 Valentyn Shevchenko
# SPDX-License-Identifier: Apache-2.0

description: Fake PWM controller for unit testing

compatible: "test,fake-pwm"

include: base.yaml

properties:
  reg:
    required: true

  "#pwm-cells":
    type: int
    const: 3

pwm-cells:
  - channel
  - period
  - flags
```

## src/main.c
```c
/*
 * Copyright (c) 2024 Valentyn Shevchenko
 * SPDX-License-Identifier: Apache-2.0
 *
 * Unit tests for the pwm-servo driver.
 *
 * Board: native_sim
 *   Servo: min=1000 µs, max=2000 µs, init_value=50
 *
 * Tests cover three areas:
 *   1. Pulse-width mapping  — value→ns arithmetic at boundaries and midpoints.
 *   2. Read-back            — current_value cache correctness.
 *   3. Error handling       — invalid input and PWM failure recovery.
 */

#include <zephyr/device.h>
#include <zephyr/drivers/pwm.h>
#include <zephyr/drivers/pwm_servo.h>
#include <zephyr/ztest.h>
#include "fake_pwm.h"

#define SERVO_NODE    DT_NODELABEL(servo_test)
#define FAKE_PWM_NODE DT_NODELABEL(fake_pwm0)

/* ns equivalents for the test servo's range */
#define PULSE_MIN_NS  PWM_USEC(1000)   /* 1 000 000 ns */
#define PULSE_MAX_NS  PWM_USEC(2000)   /* 2 000 000 ns */
#define PULSE_MID_NS  PWM_USEC(1500)   /* 1 500 000 ns */
#define PULSE_25_NS   PWM_USEC(1250)   /* 1 250 000 ns */
#define PULSE_75_NS   PWM_USEC(1750)   /* 1 750 000 ns */

static const struct device *servo;
static const struct device *fake_pwm;

static void *suite_setup(void)
{
	servo    = DEVICE_DT_GET(SERVO_NODE);
	fake_pwm = DEVICE_DT_GET(FAKE_PWM_NODE);

	zassert_true(device_is_ready(fake_pwm), "fake_pwm not ready");
	zassert_true(device_is_ready(servo),    "servo not ready");
	return NULL;
}

static void before_each(void *unused)
{
	/* Reset to a known state before every test. */
	fake_pwm_inject_err(fake_pwm, 0);
	servo_write(servo, 50);
}

ZTEST_SUITE(pwm_servo, NULL, suite_setup, before_each, NULL, NULL);

/* ── 1. Pulse-width mapping ──────────────────────────────────────────────── */

ZTEST(pwm_servo, test_init_sets_init_value_pulse)
{
	/*
	 * init_value=50 → MAP(50, 1000000, 2000000) = 1500000 ns.
	 * The driver calls channel_set during init, so the fake PWM should
	 * have seen this pulse before the first test runs.
	 */
	zassert_equal(fake_pwm_last_pulse_ns(fake_pwm), PULSE_MID_NS,
		"init pulse mismatch: got %u, want %u",
		fake_pwm_last_pulse_ns(fake_pwm), PULSE_MID_NS);
}

ZTEST(pwm_servo, test_write_min_maps_to_min_pulse)
{
	zassert_ok(servo_write(servo, 0));
	zassert_equal(fake_pwm_last_pulse_ns(fake_pwm), PULSE_MIN_NS,
		"value=0 pulse mismatch: got %u, want %u",
		fake_pwm_last_pulse_ns(fake_pwm), PULSE_MIN_NS);
}

ZTEST(pwm_servo, test_write_max_maps_to_max_pulse)
{
	zassert_ok(servo_write(servo, 100));
	zassert_equal(fake_pwm_last_pulse_ns(fake_pwm), PULSE_MAX_NS,
		"value=100 pulse mismatch: got %u, want %u",
		fake_pwm_last_pulse_ns(fake_pwm), PULSE_MAX_NS);
}

ZTEST(pwm_servo, test_write_midpoint_maps_to_mid_pulse)
{
	zassert_ok(servo_write(servo, 50));
	zassert_equal(fake_pwm_last_pulse_ns(fake_pwm), PULSE_MID_NS,
		"value=50 pulse mismatch: got %u, want %u",
		fake_pwm_last_pulse_ns(fake_pwm), PULSE_MID_NS);
}

ZTEST(pwm_servo, test_write_quarter_maps_correctly)
{
	zassert_ok(servo_write(servo, 25));
	zassert_equal(fake_pwm_last_pulse_ns(fake_pwm), PULSE_25_NS,
		"value=25 pulse mismatch: got %u, want %u",
		fake_pwm_last_pulse_ns(fake_pwm), PULSE_25_NS);
}

ZTEST(pwm_servo, test_write_three_quarter_maps_correctly)
{
	zassert_ok(servo_write(servo, 75));
	zassert_equal(fake_pwm_last_pulse_ns(fake_pwm), PULSE_75_NS,
		"value=75 pulse mismatch: got %u, want %u",
		fake_pwm_last_pulse_ns(fake_pwm), PULSE_75_NS);
}

/* ── 2. Read-back ────────────────────────────────────────────────────────── */

ZTEST(pwm_servo, test_read_returns_last_written_value)
{
	uint8_t val;

	zassert_ok(servo_write(servo, 73));
	zassert_ok(servo_read(servo, &val));
	zassert_equal(val, 73, "read back %u, want 73", val);
}

ZTEST(pwm_servo, test_sequential_writes_update_readback)
{
	uint8_t val;

	zassert_ok(servo_write(servo, 10));
	zassert_ok(servo_write(servo, 90));
	zassert_ok(servo_read(servo, &val));
	zassert_equal(val, 90, "read back %u after two writes, want 90", val);
}

/* ── 3. Error handling ───────────────────────────────────────────────────── */

ZTEST(pwm_servo, test_write_above_100_returns_einval)
{
	zassert_equal(servo_write(servo, 101), -EINVAL);
}

ZTEST(pwm_servo, test_write_invalid_does_not_change_readback)
{
	uint8_t val;

	zassert_ok(servo_write(servo, 30));
	zassert_equal(servo_write(servo, 101), -EINVAL);
	zassert_ok(servo_read(servo, &val));
	zassert_equal(val, 30, "invalid write corrupted readback: got %u", val);
}

ZTEST(pwm_servo, test_pwm_error_preserves_cached_value)
{
	/*
	 * Regression: channel_set used to update current_value before calling
	 * pwm_set_pulse_dt. On a PWM error the cache would reflect a position
	 * the hardware never reached.
	 *
	 * After the fix, current_value must only be updated on success.
	 */
	uint8_t val;

	zassert_ok(servo_write(servo, 30));
	fake_pwm_inject_err(fake_pwm, -EIO);
	zassert_equal(servo_write(servo, 70), -EIO);

	zassert_ok(servo_read(servo, &val));
	zassert_equal(val, 30,
		"cache corrupted on PWM error: got %u, want 30", val);
}

ZTEST(pwm_servo, test_pwm_error_does_not_change_pulse)
{
	/* Hardware state must also be unchanged after an injected error. */
	zassert_ok(servo_write(servo, 30));
	uint32_t pulse_before = fake_pwm_last_pulse_ns(fake_pwm);

	fake_pwm_inject_err(fake_pwm, -EIO);
	servo_write(servo, 70);

	zassert_equal(fake_pwm_last_pulse_ns(fake_pwm), pulse_before,
		"pulse changed despite PWM error");
}

ZTEST(pwm_servo, test_recovery_after_pwm_error)
{
	/* Driver must work normally after a transient PWM failure. */
	uint8_t val;

	fake_pwm_inject_err(fake_pwm, -EIO);
	servo_write(servo, 70);           /* fails */

	zassert_ok(servo_write(servo, 80));   /* must succeed */
	zassert_ok(servo_read(servo, &val));
	zassert_equal(val, 80, "got %u after recovery, want 80", val);
	zassert_equal(fake_pwm_last_pulse_ns(fake_pwm), PWM_USEC(1800));
}
```

## src/fake_pwm.c
```c
/*
 * Copyright (c) 2024 Valentyn Shevchenko
 * SPDX-License-Identifier: Apache-2.0
 */

#define DT_DRV_COMPAT test_fake_pwm

#include <zephyr/device.h>
#include <zephyr/devicetree.h>
#include <zephyr/drivers/pwm.h>
#include <zephyr/kernel.h>
#include "fake_pwm.h"

struct fake_pwm_data {
	uint32_t last_pulse;   /* cycles; == ns because clk = NSEC_PER_SEC */
	int      inject_err;
};

static int fake_set_cycles(const struct device *dev, uint32_t channel,
			    uint32_t period, uint32_t pulse, pwm_flags_t flags)
{
	struct fake_pwm_data *data = dev->data;

	if (data->inject_err) {
		int err = data->inject_err;

		data->inject_err = 0;
		return err;
	}
	data->last_pulse = pulse;
	return 0;
}

static int fake_get_cycles_per_sec(const struct device *dev, uint32_t channel,
				   uint64_t *cycles)
{
	/* 1 cycle == 1 ns  →  pulse_cycles == pulse_ns in assertions */
	*cycles = NSEC_PER_SEC;
	return 0;
}

static const struct pwm_driver_api fake_pwm_api = {
	.set_cycles         = fake_set_cycles,
	.get_cycles_per_sec = fake_get_cycles_per_sec,
};

uint32_t fake_pwm_last_pulse_ns(const struct device *dev)
{
	return ((const struct fake_pwm_data *)dev->data)->last_pulse;
}

void fake_pwm_inject_err(const struct device *dev, int err)
{
	((struct fake_pwm_data *)dev->data)->inject_err = err;
}

static int fake_pwm_init(const struct device *dev)
{
	return 0;
}

#define FAKE_PWM_DEFINE(n) \
	static struct fake_pwm_data fake_pwm_data_##n; \
	DEVICE_DT_INST_DEFINE(n, fake_pwm_init, NULL, \
			      &fake_pwm_data_##n, NULL, \
			      POST_KERNEL, 60, &fake_pwm_api);

DT_INST_FOREACH_STATUS_OKAY(FAKE_PWM_DEFINE)
```

## src/fake_pwm.h
```c
/*
 * Copyright (c) 2024 Valentyn Shevchenko
 * SPDX-License-Identifier: Apache-2.0
 */
#ifndef FAKE_PWM_H_
#define FAKE_PWM_H_

#include <zephyr/device.h>

/*
 * Returns the pulse width (in nanoseconds) from the last successful
 * pwm_set_pulse_dt() call.  Valid because get_cycles_per_sec == NSEC_PER_SEC,
 * so stored cycles == nanoseconds numerically.
 */
uint32_t fake_pwm_last_pulse_ns(const struct device *dev);

/* Arm the fake to return err on the next set_cycles call (one-shot). */
void fake_pwm_inject_err(const struct device *dev, int err);

#endif /* FAKE_PWM_H_ */
```
