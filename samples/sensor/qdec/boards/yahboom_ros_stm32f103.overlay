/*
 * Copyright (c) 2022 STMicroelectronics
 *
 * SPDX-License-Identifier: Apache-2.0
 *
 * Application overlay for creating quadrature decoder device instance
 */
#include <zephyr/dt-bindings/sensor/qdec_stm32.h>

/ {
	aliases {
		qdec0 = &qdec;
	};
};

&timers2 {
	status = "okay";

	qdec: qdec_t2_m1 {
		status = "okay";
		/* can be changed to 836 if EncoderMode is set to LL_TIM_ENCODERMODE_X4_TI12 */
		st,counts-per-revolution = <418>;
		st,input-filter-level = <NO_FILTER>;
	};
};
